## star64.its
```
/dts-v1/;

/ {
    description = "Kernel fitImage for Star64";
    #address-cells = <1>;

    images {
        kernel-1 {
            description = "Linux kernel";
            data = /incbin/("/mnt/usb-ssd/Star64_linux/arch/riscv/boot/Image");
            type = "kernel";
            arch = "RISCV";
            os = "linux";
            compression = "none";
            load = <0x40200000>;
            entry = <0x40200000>;
            hash {
                algo = "sha256";
            };
        };
        star64.dtb {
            description = "Flattened Device Tree blob";
            data = /incbin/("/mnt/usb-ssd/Star64_linux/arch/riscv/boot/dts/starfive/jh7110-pine64-star64.dtb");
            type = "flat_dt";
            arch = "RISCV";
            compression = "none";
            load = <0x46000000>;
            hash {
                algo = "sha256";
            };
        };
        ramdisk {
            description = "Ramdisk";
            data = /incbin/("/tmp/initrd");
            type = "ramdisk";
            arch = "RISCV";
            os = "linux";
            compression = "none";
            hash {
                algo = "sha256";
            };
        };
    };
    configurations {
        default = "star64";
        star64 {
            description = "1 Linux kernel, FDT blob, ramdisk";
            kernel = "kernel-1";
            fdt = "star64.dtb";
            ramdisk = "ramdisk";
            hash {
                algo = "sha256";
            };
        };
    };
};
```
